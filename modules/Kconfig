## modules/Kconfig
```kconfig
menuconfig MODULES
    bool "Module config"
    default y
    modules
    select EXECMEM
    help
      This option allows you to build parts of the kernel as modules.

if MODULES
    source "modules/test/Kconfig"
    source "modules/test2/Kconfig"
    source "modules/UxTK/Kconfig"
    source "modules/task/Kconfig"
    source "modules/eloader/Kconfig"
    source "modules/linux_syscall/Kconfig"
    source "modules/dpi/Kconfig"
    source "modules/user/Kconfig"
endif
```

## modules/test/Kconfig
```kconfig
menu "test"
    config test
        tristate "Test_Module"
        default m
        depends on m
        help
            "just a test.XD"
endmenu
```

## modules/test2/Kconfig
```kconfig
menu "test2"
    config test2
        tristate "Test_Module2"
        default m
        depends on m
        help
            "just a test XD."
endmenu
```
